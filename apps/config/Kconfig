## apps/config/Kconfig
```kconfig
config CONFIG_CMD
	tristate "Config manager shell command"
	default n
	---help---
		NSH command for persistent configuration management.
		Stores key-value pairs in LittleFS at /config/.
```

## apps/hactl/Kconfig
```kconfig
config HACTL_CMD
	tristate "Home Assistant control command"
	default n
	depends on NET_TCP && MMWAVE_LD2410
	---help---
		NSH command to manage Home Assistant integration.
		Pushes mmWave sensor state to HA REST API and
		provides background auto-reporting.
```

## apps/mmwave/Kconfig
```kconfig
/****************************************************************************
 * apps/mmwave/Kconfig
 ****************************************************************************/

config MMWAVE_CMD
	tristate "mmWave sensor shell command"
	default n
	depends on MMWAVE_LD2410
	---help---
		NSH command to read and configure the LD2410 mmWave sensor.
		Provides real-time presence detection readout, engineering
		mode, gate sensitivity configuration, and JSON output.
```

## apps/sysinfo/Kconfig
```kconfig
config SYSINFO_CMD
	tristate "System info shell command"
	default n
	---help---
		NSH command to display system information including
		heap usage, uptime, CPU info, and sensor status.
```

## boards/esp32c6/defconfig
```kconfig
#
# NuttX defconfig for mmWave OS on ESP32-C6
#
# Base: esp32c6-devkitc:nsh
# Overlay: mmWave driver, Wi-Fi, LittleFS, custom apps
#
# To use: copy this to nuttx/.config or apply with:
#   cd nuttx && tools/configure.sh -l ../mmwave-os/boards/esp32c6/defconfig
#

#
# Board & Architecture
#
CONFIG_ARCH="risc-v"
CONFIG_ARCH_CHIP="esp32c6"
CONFIG_ARCH_BOARD="esp32c6-devkitc"
CONFIG_ARCH_BOARD_ESP32C6_DEVKITC=y
CONFIG_ESP32C6_CPU_FREQ_160=y
CONFIG_ARCH_INTERRUPTSTACK=2048
CONFIG_ARCH_STACKDUMP=y

#
# RTOS Features
#
CONFIG_SCHED_WAITPID=y
CONFIG_SCHED_LPWORK=y
CONFIG_SCHED_HPWORK=y
CONFIG_SCHED_HPWORKSTACKSIZE=2048
CONFIG_SCHED_LPWORKSTACKSIZE=2048
CONFIG_START_YEAR=2026
CONFIG_START_MONTH=2
CONFIG_START_DAY=22
CONFIG_USEC_PER_TICK=1000
CONFIG_SYSTEMTICK_HOOK=y

#
# Memory
#
CONFIG_MM_REGIONS=1
CONFIG_RAM_SIZE=327680
CONFIG_IDLETHREAD_STACKSIZE=2048
CONFIG_PTHREAD_STACK_MIN=512
CONFIG_PTHREAD_STACK_DEFAULT=2048

#
# Serial Console (USB-JTAG on ESP32-C6)
#
CONFIG_UART0_SERIAL_CONSOLE=y
CONFIG_UART0_BAUD=115200
CONFIG_UART0_BITS=8
CONFIG_UART0_PARITY=0
CONFIG_UART0_2STOP=0
CONFIG_SERIAL=y
CONFIG_SERIAL_TERMIOS=y
CONFIG_STANDARD_SERIAL=y

#
# UART1 — mmWave LD2410 sensor
#
CONFIG_ESP32C6_UART1=y
CONFIG_UART1_BAUD=256000
CONFIG_UART1_BITS=8
CONFIG_UART1_PARITY=0
CONFIG_UART1_2STOP=0
CONFIG_UART1_RXBUFSIZE=256
CONFIG_UART1_TXBUFSIZE=128

#
# File Systems
#
CONFIG_FS_LITTLEFS=y
CONFIG_FS_PROCFS=y
CONFIG_FS_PROCFS_REGISTER=y

#
# LittleFS partition for /config
#
CONFIG_MTD=y
CONFIG_ESP32C6_SPIFLASH=y
CONFIG_ESP32C6_STORAGE_MTD_OFFSET=0x310000
CONFIG_ESP32C6_STORAGE_MTD_SIZE=0x40000

#
# Networking — Wi-Fi
#
CONFIG_NET=y
CONFIG_NET_TCP=y
CONFIG_NET_UDP=y
CONFIG_NET_ICMP=y
CONFIG_NET_SOCKOPTS=y
CONFIG_NET_TCP_WRITE_BUFFERS=y
CONFIG_NET_STATISTICS=y
CONFIG_NETDB_DNSCLIENT=y
CONFIG_NETDB_DNSSERVER_IPv4ADDR=0x08080808
CONFIG_NETUTILS_DHCPC=y
CONFIG_NETUTILS_NETLIB=y

CONFIG_ESP32C6_WIFI=y
CONFIG_ESP32C6_WIFI_STATION_SOFTAP=y
CONFIG_WIRELESS_WAPI=y
CONFIG_DRIVERS_WIRELESS=y

#
# NSH (NuttX Shell)
#
CONFIG_NSH_LIBRARY=y
CONFIG_NSH_READLINE=y
CONFIG_NSH_BUILTIN_APPS=y
CONFIG_NSH_FILEIOSIZE=512
CONFIG_NSH_LINELEN=128
CONFIG_NSH_CMDPARMS=y
CONFIG_NSH_MAXARGUMENTS=12
CONFIG_NSH_NESTDEPTH=4
CONFIG_NSH_ROMFSETC=y
CONFIG_NSH_ARCHROMFS=y
CONFIG_NSH_CONSOLE=y
CONFIG_NSH_TELNET=y
CONFIG_NSH_ARCHINIT=y

#
# NSH Init Script
# Executed on boot from /etc/init.d/rcS inside ROMFS
#
CONFIG_NSH_ROMFSMOUNTPT="/etc"
CONFIG_NSH_INITSCRIPT="init.d/rcS"
CONFIG_NSH_SYSINITSCRIPT="init.d/rc.sysinit"

#
# mmWave Driver
#
CONFIG_MMWAVE_LD2410=y
CONFIG_MMWAVE_LD2410_UART_PATH="/dev/ttyS1"
CONFIG_MMWAVE_LD2410_BAUD=256000
CONFIG_MMWAVE_LD2410_DEVPATH="/dev/mmwave0"

#
# Custom Apps
#
CONFIG_MMWAVE_CMD=y
CONFIG_HACTL_CMD=y
CONFIG_SYSINFO_CMD=y
CONFIG_CONFIG_CMD=y

#
# System utilities
#
CONFIG_SYSTEM_NSH=y
CONFIG_SYSTEM_PING=y
CONFIG_SYSTEM_IFCONFIG=y

#
# Watchdog
#
CONFIG_WATCHDOG=y
CONFIG_WATCHDOG_AUTOMONITOR=y
CONFIG_WATCHDOG_AUTOMONITOR_TIMEOUT=10

#
# Power Management
#
CONFIG_PM=y
CONFIG_PM_NDOMAINS=1

#
# Debug (disable for production)
#
CONFIG_DEBUG_FEATURES=y
CONFIG_DEBUG_INFO=y
CONFIG_DEBUG_WARN=y
CONFIG_DEBUG_ERROR=y
CONFIG_DEBUG_SENSORS=y
CONFIG_DEBUG_NET=y
CONFIG_STACK_COLORATION=y
```

## drivers/mmwave/Kconfig
```kconfig
#
# For a description of the syntax of this configuration file,
# see the file kconfig-language.txt in the NuttX tools repository.
#

menuconfig MMWAVE_LD2410
	bool "HLK-LD2410 mmWave Radar Sensor"
	default n
	depends on SERIAL
	---help---
		Enable the HLK-LD2410 24GHz mmWave radar sensor driver.
		The sensor communicates over UART and provides presence,
		motion, and static target detection data.

if MMWAVE_LD2410

config MMWAVE_LD2410_UART_PATH
	string "UART device path"
	default "/dev/ttyS1"
	---help---
		Path to the UART device connected to the LD2410 sensor.

config MMWAVE_LD2410_BAUD
	int "UART baud rate"
	default 256000
	---help---
		Baud rate for LD2410 UART communication.
		Default is 256000 as set by the LD2410 factory config.
		Valid values: 9600, 19200, 38400, 57600, 115200,
		230400, 256000, 460800

config MMWAVE_LD2410_DEVPATH
	string "Device node path"
	default "/dev/mmwave0"
	---help---
		Path to register the mmWave character device.

endif # MMWAVE_LD2410
```
